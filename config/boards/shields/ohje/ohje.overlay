#include <dt-bindings/zmk/matrix_transform.h>

/ {
    chosen {
        zmk,kscan = &kscan0;
    };

    default_transform: keymap_transform_0 {
        compatible = "zmk,matrix-transform" ;
        columns = <4>;
        rows = <1>;
        // transoform from:
        // ┌───┬───┬
        // | O | H |
        // ├───┼───┤
        // | J | E |
        // ┘───┴───┘
        // transform to:
        // ┌───┬───┬───┬───┐
        // | O | H | J | E |
        // ┴───┴───┘───┴───┘
        map = <
RC(0,0) RC(0,1) RC(1,0) RC(1,1)
        >;

    };

    kscan0: kscan_0 {
        compatible = "zmk,kscan-gpio-matrix";
        label = "KSCAN";
        diode-direction = "col2row";

        col-gpios
            = <&gpio0 16 GPIO_ACTIVE_HIGH>
            , <&gpio0 23 GPIO_ACTIVE_HIGH>
            ;

        row-gpios
            = <&gpio0 9 (GPIO_ACTIVE_HIGH | GPIO_PULL_DOWN)>
            , <&gpio0 7 (GPIO_ACTIVE_HIGH | GPIO_PULL_DOWN)>
            ;
    };
};
